## src/mainboard/eglobal/Kconfig
```kconfig
if VENDOR_EGLOBAL

choice
	prompt "Mainboard model"

source "src/mainboard/eglobal/*/Kconfig.name"

endchoice

source "src/mainboard/eglobal/*/Kconfig"

config MAINBOARD_VENDOR
	default "Eglobal"

endif
```

## src/mainboard/eglobal/v310-cml/Kconfig
```kconfig
if BOARD_EGLOBAL_V310_CML

config BOARD_SPECIFIC_OPTIONS
	def_bool y
	select BOARD_ROMSIZE_KB_16384
	select HAVE_ACPI_RESUME
	select HAVE_ACPI_TABLES
	select HAVE_SMI_HANDLER
	select INTEL_GMA_HAVE_VBT
	select INTEL_LPSS_UART_FOR_CONSOLE
	select NO_UART_ON_SUPERIO
	select SOC_INTEL_COMETLAKE_1
	select SOC_INTEL_COMMON_BLOCK_HDA
	select SOC_INTEL_COMMON_BLOCK_HDA_VERB
	select SPD_READ_BY_WORD
	select SUPERIO_ITE_IT8728F
	select USE_LEGACY_8254_TIMER

config MAINBOARD_DIR
	string
	default "eglobal/v310-cml"

config MAINBOARD_PART_NUMBER
	string
	default "V310-CML"

config MAINBOARD_SMBIOS_MANUFACTURER
	string
	default "EGLOBAL"

config CBFS_SIZE
	hex
	default 0xC00000

config MAX_CPUS
	int
	default 8

config DIMM_MAX
	int
	default 2

config DIMM_SPD_SIZE
	int
	default 512

config VGA_BIOS_ID
	string
	default "8086,9b41"

config NO_POST
	bool
	default y

config CONSOLE_SERIAL
	bool
	default n
endif
```

## src/mainboard/shuttle/sh170r6/Kconfig
```kconfig
if BOARD_SHUTTLE_SH170R6

config BOARD_SPECIFIC_OPTIONS
	def_bool y
	select BOARD_ROMSIZE_KB_8192
	select HAVE_ACPI_RESUME
	select HAVE_ACPI_TABLES
	select HAVE_OPTION_TABLE
	select HAVE_CMOS_DEFAULT
	select INTEL_GMA_HAVE_VBT
	select MAINBOARD_USES_IFD_GBE_REGION
	select MAINBOARD_HAS_LIBGFXINIT
	select SOC_INTEL_KABYLAKE
	select SKYLAKE_SOC_PCH_H
	select SUPERIO_ITE_IT8772F

config IRQ_SLOT_COUNT
	int
	default 18

config MAINBOARD_DIR
	string
	default "shuttle/sh170r6"

config MAINBOARD_PART_NUMBER
	string
	default "SH170R6"

config MAX_CPUS
	int
	default 8

config DEVICETREE
	string
	default "devicetree.cb"

config PRERAM_CBMEM_CONSOLE_SIZE
	hex
	default 0xd00

config DIMM_SPD_SIZE
	int
	default 512 #DDR4

# This is overridden if CMOS is used for configuration values.
config MAINBOARD_POWER_ON_AFTER_POWER_FAIL
	bool
	default n

endif
```
